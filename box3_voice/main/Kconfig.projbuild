## box3_voice/main/Kconfig.projbuild
```kconfig
menu "Zacus BOX-3 Voice Configuration"

    config ZACUS_WIFI_SSID
        string "WiFi SSID"
        default "zacus-net"
        help
            WiFi network name for connecting to the voice bridge.

    config ZACUS_WIFI_PASSWORD
        string "WiFi Password"
        default ""
        help
            WiFi password. Leave empty for open networks.

    config ZACUS_VOICE_BRIDGE_URL
        string "Voice Bridge WebSocket URL"
        default "ws://192.168.0.119:8200/voice/ws"
        help
            WebSocket endpoint for the mascarade voice bridge.
            The bridge routes voice commands to the hints engine.

    config ZACUS_VOICE_TOKEN
        string "Voice Bridge Auth Token"
        default ""
        help
            Authentication token for the voice bridge.
            If set, appended as ?token=<value> query parameter.

    config ZACUS_WAKE_WORD
        string "Wake Word"
        default "hi esp"
        help
            Wake word for ESP-SR WakeNet activation.
            Supported: "hi esp", "alexa", "hey siri" (WakeNet9).

    config ZACUS_SPEAKER_VOLUME
        int "Default Speaker Volume (0-100)"
        default 70
        range 0 100
        help
            Default speaker volume at boot.

    config ZACUS_MIC_GAIN
        int "Microphone Gain (0-100)"
        default 80
        range 0 100
        help
            Microphone input gain for speech recognition.

    config ZACUS_ENABLE_DISPLAY
        bool "Enable LCD Display"
        default y
        help
            Enable the ILI9341 display for status feedback.

endmenu
```

## box3_voice/sdkconfig.defaults
```kconfig
# Target: ESP32-S3
CONFIG_IDF_TARGET="esp32s3"

# Flash: 16MB
CONFIG_ESPTOOLPY_FLASHSIZE_16MB=y
CONFIG_ESPTOOLPY_FLASHMODE_QIO=y
CONFIG_ESPTOOLPY_FLASHFREQ_80M=y

# Partition table
CONFIG_PARTITION_TABLE_CUSTOM=y
CONFIG_PARTITION_TABLE_CUSTOM_FILENAME="partitions.csv"

# PSRAM: Octal 8MB
CONFIG_ESP32S3_SPIRAM_SUPPORT=y
CONFIG_SPIRAM_MODE_OCT=y
CONFIG_SPIRAM_SPEED_80M=y
CONFIG_SPIRAM_BOOT_INIT=y
CONFIG_SPIRAM_ALLOW_STACK_EXTERNAL_MEMORY=y

# ESP-SR: WakeNet + MultiNet
CONFIG_ESP_SR_WAKENET_ENABLE=y
CONFIG_ESP_SR_WAKENET9_HIESP=y
CONFIG_ESP_SR_MULTINET_ENABLE=y

# WiFi
CONFIG_ESP_WIFI_STATIC_RX_BUFFER_NUM=16
CONFIG_ESP_WIFI_DYNAMIC_RX_BUFFER_NUM=64
CONFIG_ESP_WIFI_DYNAMIC_TX_BUFFER_NUM=64

# FreeRTOS
CONFIG_FREERTOS_HZ=1000
CONFIG_FREERTOS_TIMER_TASK_STACK_DEPTH=4096

# Logging
CONFIG_LOG_DEFAULT_LEVEL_INFO=y

# Watchdog: extend for model loading
CONFIG_ESP_TASK_WDT_TIMEOUT_S=30

# Enable HTTPS / TLS for voice bridge
CONFIG_ESP_TLS_USING_MBEDTLS=y
CONFIG_MBEDTLS_DYNAMIC_BUFFER=y

# Heap: place large buffers in PSRAM
CONFIG_SPIRAM_MALLOC_ALWAYSINTERNAL=4096
CONFIG_SPIRAM_MALLOC_RESERVE_INTERNAL=32768
```
